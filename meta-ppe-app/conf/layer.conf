## meta-ppe-app/conf/layer.conf
```bitbake
# We have a conf and classes directory, add to BBPATH
BBPATH .= ":${LAYERDIR}"

# We have recipes-* directories, add to BBFILES
BBFILES += "${LAYERDIR}/recipes-*/*/*.bb \
            ${LAYERDIR}/recipes-*/*/*.bbappend"

BBFILE_COLLECTIONS += "meta-ppe-app"
BBFILE_PATTERN_meta-ppe-app = "^${LAYERDIR}/"
BBFILE_PRIORITY_meta-ppe-app = "6"

LAYERDEPENDS_meta-ppe-app = "core"
LAYERSERIES_COMPAT_meta-ppe-app = "scarthgap"
```

## meta-ppe-lite/conf/distro/ppe-lite.conf
```bitbake
# Kế thừa policy của poky rồi override tối thiểu
require conf/distro/poky.conf

DISTRO          = "ppe-lite"
DISTRO_NAME     = "PPE Lite Distro"
DISTRO_VERSION  = "0.1"

# Providers & init (đủ cho test dịch vụ, mạng)
INIT_MANAGER = "systemd"
VIRTUAL-RUNTIME_init_manager        = "systemd"
VIRTUAL-RUNTIME_dev_manager         = "udev"
VIRTUAL-RUNTIME_login_manager       = "shadow-base"
VIRTUAL-RUNTIME_base-utils          = "busybox"
VIRTUAL-RUNTIME_base-utils-syslog   = "busybox-syslog"

# Định dạng gói & tính năng
PACKAGE_CLASSES = "package_ipk"
DISTRO_FEATURES:append = " systemd ipv4 ipv6 "
DISTRO_FEATURES:remove = " x11 "

# Artifact mặc định
IMAGE_FSTYPES ?= "wic.gz"

# Thống kê build (hữu ích cho báo cáo)
INHERIT += "buildstats buildhistory"
BUILDHISTORY_COMMIT = "1"
```

## meta-ppe-lite/conf/layer.conf
```bitbake
# We have a conf and classes directory, add to BBPATH
BBPATH .= ":${LAYERDIR}"

# We have recipes-* directories, add to BBFILES
BBFILES += "${LAYERDIR}/recipes-*/*/*.bb \
            ${LAYERDIR}/recipes-*/*/*.bbappend"

BBFILE_COLLECTIONS += "meta-ppe-lite"
BBFILE_PATTERN_meta-ppe-lite = "^${LAYERDIR}/"
BBFILE_PRIORITY_meta-ppe-lite = "6"

LAYERDEPENDS_meta-ppe-lite = "core"
LAYERSERIES_COMPAT_meta-ppe-lite = "scarthgap"
```

## meta-ppe-middleware/conf/layer.conf
```bitbake
# We have a conf and classes directory, add to BBPATH
BBPATH .= ":${LAYERDIR}"

# We have recipes-* directories, add to BBFILES
BBFILES += "${LAYERDIR}/recipes-*/*/*.bb \
            ${LAYERDIR}/recipes-*/*/*.bbappend"

BBFILE_COLLECTIONS += "meta-ppe-middleware"
BBFILE_PATTERN_meta-ppe-middleware = "^${LAYERDIR}/"
BBFILE_PRIORITY_meta-ppe-middleware = "6"

LAYERDEPENDS_meta-ppe-middleware = "core"
LAYERSERIES_COMPAT_meta-ppe-middleware = "scarthgap"
```
